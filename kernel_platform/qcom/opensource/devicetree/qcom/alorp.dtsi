// SPDX-License-Identifier: BSD-3-Clause
/*
 * Copyright (c) Qualcomm Technologies, Inc. and/or its subsidiaries.
 */

#include "alor.dtsi"

/ {
	model = "Qualcomm Technologies, Inc. AlorP";
	compatible = "qcom,alorp";
	qcom,msm-id = <727 0x10000>;
};
