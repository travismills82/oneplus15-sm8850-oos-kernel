// SPDX-License-Identifier: BSD-3-Clause
/*
 * Copyright (c) Qualcomm Technologies, Inc. and/or its subsidiaries.
 */

/dts-v1/;

#include "alorp.dtsi"

/ {
	model = "Qualcomm Technologies, Inc. AlorP SoC";
	compatible = "qcom,alorp";
	qcom,board-id = <0 0>;
};
