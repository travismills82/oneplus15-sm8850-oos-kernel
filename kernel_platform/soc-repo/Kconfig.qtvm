## kernel_platform/soc-repo/drivers/cpufreq/Kconfig.arm
```kconfig
# SPDX-License-Identifier: GPL-2.0-only
#
# ARM CPU Frequency scaling drivers
#

config ARM_QCOM_CPUFREQ_NVMEM
	tristate "Qualcomm nvmem based CPUFreq"
	depends on ARCH_QCOM || COMPILE_TEST
	depends on NVMEM_QCOM_QFPROM
	depends on QCOM_SMEM
	select PM_OPP
	help
	  This adds the CPUFreq driver for Qualcomm Kryo SoC based boards.

	  If in doubt, say N.

config ARM_QCOM_CPUFREQ_HW
	tristate "QCOM CPUFreq HW driver"
	depends on ARCH_QCOM || COMPILE_TEST
	depends on COMMON_CLK
	help
	  Support for the CPUFreq HW driver.
	  Some QCOM chipsets have a HW engine to offload the steps
	  necessary for changing the frequency of the CPUs. Firmware loaded
	  in this engine exposes a programming interface to the OS.
	  The driver implements the cpufreq interface for this HW engine.
	  Say Y if you want to support CPUFreq HW.

config ARM_QCOM_CPUFREQ_HW_DEBUG
	tristate "QCOM CPUFreq HW debug"
	depends on ARM_QCOM_CPUFREQ_HW
	help
	  Support for the CPUFreq HW debug.
	  CPUFreq HW debug provide the support to print the CPUFreq HW debug
	  registers.
	  Say Y if you want to support CPUFreq HW Debug.

config ARM_QCOM_CPUFREQ_THERMAL
	tristate "QCOM CPUFreq thermal notification driver"
	depends on ARCH_QCOM || COMPILE_TEST
	help
	  Support for the CPUFreq thermal pressure notification driver. Some
	  QCOM chipsets have a separate firmware entity that monitors the
	  current thermal limits of the CPUs. The firmware communicates the
	  thermal limits to HLOS through dedicated mailboxes. This driver
	  registers for those mailbox notification and informs the scheduler.
	  Say Y if you want to support these mailbox thermal notifications.
```

## kernel_platform/soc-repo/drivers/cpuidle/Kconfig
```kconfig
# SPDX-License-Identifier: GPL-2.0-only
menu "CPU Idle"

if CPU_IDLE

config CPU_IDLE_GOV_QCOM_LPM
    tristate "Qualcomm Technologies, Inc. CPU and Cluster governor"
    depends on ARCH_QCOM
    depends on ARM_PSCI_CPUIDLE
    help
      This governor implements effective cpu and cluster idle state
      selection with help of scheduler inputs, cpu idle state prediction
      and cluster idle state prediction algorithms.

      The predicted sleep time, latency requirement for the
      CPU and the idle state chosen based on the parameters are all
      logged in the trace.

endif

endmenu
```

## kernel_platform/soc-repo/drivers/devfreq/Kconfig
```kconfig
# SPDX-License-Identifier: GPL-2.0-only
if PM_DEVFREQ

comment "DEVFREQ Governors"

config DEVFREQ_GOV_QCOM_ADRENO_TZ
	tristate "Qualcomm Technologies, Inc. GPU frequency governor"
	help
	  GPU frequency governor for the Adreno GPU. Sets the frequency
	  using an "on demand" algorithm in conjunction with other
	  components on Adreno platforms. This is not useful for non-Adreno
	  devices.

config DEVFREQ_GOV_QCOM_GPUBW_MON
	tristate "Qualcomm Technologies, Inc. GPU bandwidth governor"
	depends on DEVFREQ_GOV_QCOM_ADRENO_TZ
	help
	  This governor works together with the Adreno GPU governor to
	  select bus frequency votes using an "on-demand" algorithm.
	  This governor will not be useful for non-Adreno based
	  targets.

config DEVFREQ_GOV_QCOM_ADRENO_RO
	tristate "Qualcomm Technologies, Inc. GPU frequency governor"
	help
	  This governor is intended for GMU-based DCVS targets that do not
	  support power scaling through devfreq. It is only used for querying
	  the current GPU frequency for the Adreno GPU. This is not useful for
	  non-Adreno devices.

endif # PM_DEVFREQ
```

## kernel_platform/soc-repo/drivers/dma/qcom/Kconfig
```kconfig
# SPDX-License-Identifier: GPL-2.0-only
config QCOM_BAM_DMA
	tristate "QCOM BAM DMA support"
	depends on ARCH_QCOM || (COMPILE_TEST && OF && ARM)
	select DMA_ENGINE
	select DMA_VIRTUAL_CHANNELS
	help
	  Enable support for the QCOM BAM DMA controller.  This controller
	  provides DMA capabilities for a variety of on-chip devices.

config MSM_GPI_DMA
	tristate "Qualcomm Technologies Inc GPI DMA support"
	depends on ARCH_QCOM
	select DMA_ENGINE
	select DMA_VIRTUAL_CHANNELS
	help
	  Enable support for the QCOM GPI DMA controller. This controller
	  provides DMA capabilities for a variety of peripheral buses such
	  as I2C, UART, and SPI. By using GPI dmaengine driver, bus drivers
	  can use a standardize interface that is protocol independent to
	  transfer data between DDR and peripheral.

config QCOM_GPI_DMA
        tristate "Qualcomm Technologies GPI DMA support"
        depends on ARCH_QCOM
        select DMA_ENGINE
        select DMA_VIRTUAL_CHANNELS
        help
          Enable support for the QCOM GPI DMA controller. This controller
          provides DMA capabilities for a variety of peripheral buses such
          as I2C, UART, and SPI. By using GPI dmaengine driver, bus drivers
          can use a standardize interface that is protocol independent to
          transfer data between DDR and peripheral.

config MSM_GPI_DMA_DEBUG
	bool "Qualcomm Technologies Inc GPI debug support"
	depends on MSM_GPI_DMA
	help
	  Enable detailed logging for QCOM GPI driver. Extra logging will be
	  helpful when debugging critical issues. By using GPI dmaengine driver,
	  bus drivers can use a standardize interface that is protocol independent
	  to transfer data between DDR and peripheral.
```

## kernel_platform/soc-repo/drivers/firmware/Kconfig
```kconfig
# SPDX-License-Identifier: GPL-2.0-only
#
# For a description of the syntax of this configuration file,
# see Documentation/kbuild/kconfig-language.rst.
#

menu "Firmware Drivers"

source "$(KCONFIG_EXT_PREFIX)drivers/firmware/arm_scmi/Kconfig"
source "$(KCONFIG_EXT_PREFIX)drivers/firmware/qcom/Kconfig"

endmenu
```

## kernel_platform/soc-repo/drivers/firmware/arm_scmi/Kconfig
```kconfig
# SPDX-License-Identifier: GPL-2.0-only
menu "ARM System Control and Management Interface Protocol"

if ARM_SCMI_PROTOCOL

config QTI_SCMI_PMU_PROTOCOL
	tristate "Qualcomm Technologies, Inc. SCMI PMU vendor Protocol"
	depends on ARM || ARM64 || COMPILE_TEST
	depends on ARM_SCMI_PROTOCOL && QCOM_CPUCP
	help
	  System Control and Management Interface (SCMI) pmu vendor protocol.
	  This protocol provides interface to communicate with micro controller
	  which maintains the PMU configuration for multiple clients.

	  This driver defines the commands or message ID's used for this
	  communication and also exposes the ops used by clients.

config QTI_SCMI_VENDOR_PROTOCOL
	tristate "Qualcomm Technologies, Inc. Qcom SCMI vendor Protocol"
	depends on ARM || ARM64 || COMPILE_TEST
	depends on ARM_SCMI_PROTOCOL && QCOM_CPUCP
	help
	  System Control and Management Interface (SCMI) Qcom vendor protocol.
	  This protocol provides interface to communicate with micro controller.

	  This driver defines the commands or message ID's used for this
	  communication and also exposes the ops used by clients.

config QTI_SCMI_C1DCVS_PROTOCOL
	tristate "Qualcomm Technologies, Inc. SCMI C1DCVS vendor Protocol"
	depends on ARM || ARM64 || COMPILE_TEST
	depends on ARM_SCMI_PROTOCOL && QCOM_CPUCP
	help
	  System Control and Management Interface (SCMI) c1dcvs vendor protocol.
	  This protocol provides interface to communicate with micro controller
	  which maintains the c1dcvs algorithm.

	  This driver defines the comands or message ID's used for this
	  communication and also exposes the ops used by clients.

config QTI_SCMI_PLH_PROTOCOL
	tristate "Qualcomm Technologies, Inc. SCMI PLH vendor Protocol"
	depends on ARM_SCMI_PROTOCOL && QCOM_CPUCP
	help
	  System Control and Management Interface (SCMI) plh vendor protocol
	  this protocol provides interface to communicate with micro controller
	  which is executing the plh algorithm.

	  This driver defines the comands or message ID's used for this
	  communication and also exposes the ops used by clients.

endif #ARM_SCMI_PROTOCOL

endmenu
```

## kernel_platform/soc-repo/drivers/gpu/drm/bridge/Kconfig
```kconfig
# SPDX-License-Identifier: GPL-2.0-only
config DRM_LT9611UXC
       tristate "Lontium LT9611UXC DSI/HDMI bridge"
       select SND_SOC_HDMI_CODEC if SND_SOC
       depends on OF
       select DRM_PANEL_BRIDGE
       select DRM_KMS_HELPER
       select DRM_MIPI_DSI
       select REGMAP_I2C
       help
         Driver for Lontium LT9611UXC DSI to HDMI bridge
         chip driver that converts dual DSI and I2S to
         HDMI signals
         please say Y if you have such hardware.
```

## kernel_platform/soc-repo/drivers/gpu/drm/msm/Kconfig
```kconfig
# SPDX-License-Identifier: GPL-2.0-only

config DRM_MSM_HELPER
       tristate "DRM MSM HELPER"
       select DRM_DP_AUX_BUS
       select DRM_DISPLAY_HELPER
       select DRM_DISPLAY_DP_HELPER
       help
        Wrapper symbol to allow for compilation of drm display
        helper code.

        Allows the display loadable module to link against
        helper functions.
```

## kernel_platform/soc-repo/drivers/hwmon/Kconfig
```kconfig
# SPDX-License-Identifier: GPL-2.0-only
#
# Hardware monitoring chip drivers configuration
#

if HWMON

comment "Native drivers"

config SENSORS_QTI_AMOLED_ECM
	tristate "Qualcomm Technologies, Inc. AMOLED Current Monitor"
	depends on SPMI
	help
	  Qualcomm Technologies, Inc. ECM driver supports measurement of
	  OLED display power with a time granularity in sub-frame or
	  multiple frames of image data. The measurement can be for a short
	  period (N frames) or a long period (continuous mode).

	  To compile this driver as module, choose M here: the module will
	  be called qti_amoled_ecm.

config SENSORS_QTI_BTL
	tristate "Qualcomm Technologies, Inc. Battery Temperature Logging"
	depends on SPMI
	help
	  Qualcomm Technologies, Inc. Battery temperature logging driver
	  supports reading back how long device spends within a given
	  set of temperature ranges.

	  To compile this driver as module, choose M here: the module will
	  be called qti_btl.

endif # HWMON
```

## kernel_platform/soc-repo/drivers/i2c/busses/Kconfig
```kconfig
# SPDX-License-Identifier: GPL-2.0-only
#
# Sensor device configuration
#

menu "I2C Hardware Bus support"
	depends on HAS_IOMEM

comment "I2C system bus drivers (mostly embedded / system-on-chip)"

config I2C_MSM_GENI
	tristate "Qualcomm Technologies Inc.'s GENI based I2C controller"
	depends on ARCH_QCOM || COMPILE_TEST
	depends on QCOM_GENI_SE
	default n
	help
	  This driver supports GENI serial engine based I2C controller in
	  master mode on the Qualcomm Technologies Inc.'s SoCs. If you say
	  yes to this option, support will be included for the built-in I2C
	  interface on the Qualcomm Technologies Inc.'s SoCs.

	  This driver can also be built as a module.  If so, the module
	  will be called i2c-msm-geni.

config I2C_QCOM_GENI_MSM
	tristate "Qualcomm Technologies Inc.'s GENI based I2C controller with SCMI"
	depends on ARCH_QCOM || COMPILE_TEST
	depends on QCOM_GENI_SE_MSM
	help
	  This driver supports GENI serial engine based I2C controller in
	  master mode on the Qualcomm Technologies Inc.'s SCMI support SoC. If you say
	  yes to this option, support will be included for the built-in I2C
	  interface on the Qualcomm Technologies Inc.'s SCMI support SoCs.

	  This driver can also be built as a module.  If so, the module
	  will be called i2c-geni-msm.

config I2C_QCOM_GENI
	tristate "Qualcomm Technologies Inc.'s GENI based I2C controller"
	depends on ARCH_QCOM || COMPILE_TEST
	depends on QCOM_GENI_SE
	help
	  This driver supports GENI serial engine based I2C controller in
	  master mode on the Qualcomm Technologies Inc.'s SoCs. If you say
	  yes to this option, support will be included for the built-in I2C
	  interface on the Qualcomm Technologies Inc.'s SoCs.

	  This driver can also be built as a module.  If so, the module
	  will be called i2c-qcom-geni.

endmenu
```

## kernel_platform/soc-repo/drivers/i3c/master/Kconfig
```kconfig
# SPDX-License-Identifier: GPL-2.0-only
config I3C_MASTER_MSM_GENI
	tristate "Qualcomm Technologies Inc GENI based I3C controller"
	depends on ARCH_QCOM
	depends on I3C
	depends on QCOM_GENI_SE
	help
	  If you say yes to this option, support will be included for the
	  built-in I3C interface on the Qualcomm Technologies Inc SoCs.

	  This driver can also be built as a module.  If so, the module
	  will be called i3c-master-msm-geni.
```

## kernel_platform/soc-repo/drivers/iio/adc/Kconfig
```kconfig
# SPDX-License-Identifier: GPL-2.0-only
#
# ADC drivers
#
# When adding new entries keep the list in alphabetical order

menu "Analog to digital converters"

config QCOM_VADC_COMMON
	tristate

config QCOM_SPMI_RRADC
	tristate "Qualcomm SPMI RRADC"
	depends on MFD_SPMI_PMIC
	help
	  This is for the PMIC Round Robin ADC driver.

	  This driver exposes the battery ID resistor, battery thermal, PMIC die
	  temperature, charger USB in and DC in voltage and current.

	  To compile this driver as a module, choose M here: the module will
	  be called qcom-qpmi-rradc.

config QCOM_SPMI_ADC5_GEN3
	tristate "Qualcomm Technologies Inc. SPMI PMIC5 GEN3 ADC"
	depends on SPMI
	select REGMAP_SPMI
	select QCOM_VADC_COMMON
	help
	  This is the IIO Voltage PMIC5 Gen3 ADC driver for Qualcomm Technologies Inc.

	  The driver supports multiple channels read. The ADC is a 16-bit
	  sigma-delta ADC. The hardware supports calibrated results for
	  conversion requests and clients include reading voltage phone
	  power, on board system thermistors connected to the PMIC ADC,
	  PMIC die temperature, charger temperature, battery current, USB voltage
	  input, voltage signals connected to supported PMIC GPIO inputs. The
	  hardware supports internal pull-up for thermistors and can choose between
	  a 100k, 30k and 400k pull up using the ADC channels.

	  To compile this driver as a module, choose M here: the module will
	  be called qcom-spmi-adc5-gen3.

config QCOM_SPMI_ADC5_GEN3_DEBUG_LOGGING
	bool "ADC5 GEN3 Debug Logging"
	depends on QCOM_SPMI_ADC5_GEN3
	help
	  Say yes here to enable debug logging for Qualcomm Technologies, Inc.
	  ADC5 Gen3 driver.

	  This should be enabled when ADC timeout or ADC conversion faults are
	  seen and need to be debugged. It will support dumping ADC registers
	  when these issues occur and then will trigger kernel panic to get the
	  context of the issue.

config QTI_GLINK_ADC
	tristate "Qualcomm Technologies Inc. PMIC Glink ADC"
	depends on QTI_PMIC_GLINK
	help
	  This is the IIO PMIC Glink ADC driver for Qualcomm Technologies, Inc.
	  PMICs.  It supports reading multiple ADC channels using the Glink
	  interface to communicate with charger firmware.  Channel value
	  conversion is performed in firmware.  Both converted and raw values
	  can be read.

config QCOM_SPMI_ADC5
        tristate "Qualcomm Technologies Inc. SPMI PMIC5 ADC"
        depends on SPMI
        select REGMAP_SPMI
        select QCOM_VADC_COMMON
        help
          This is the IIO Voltage PMIC5 ADC driver for Qualcomm Technologies Inc.

          The driver supports multiple channels read. The ADC is a 16-bit
          sigma-delta ADC. The hardware supports calibrated results for
          conversion requests and clients include reading voltage phone
          power, on board system thermistors connected to the PMIC ADC,
          PMIC die temperature, charger temperature, battery current, USB voltage
          input, voltage signals connected to supported PMIC GPIO inputs. The
          hardware supports internal pull-up for thermistors and can choose between
          a 100k, 30k and 400k pull up using the ADC channels.

          To compile this driver as a module, choose M here: the module will
          be called qcom-spmi-adc5.
endmenu
```
