## kernel_platform/soc-repo/Kconfig.qtvm
```kconfig
# SPDX-License-Identifier: GPL-2.0

config QTVM_HIDDEN_CONFIGS
	bool "Hidden QTVM configuration"
	select GKI_HIDDEN_DRM_CONFIGS
	select ARCH_HAS_DMA_OPS
	select DMADEVICES
	select DMA_VIRTUAL_CHANNELS
	select PINCTRL_SINGLE if (PINCTRL && OF && HAS_IOMEM)
	select AUXILIARY_BUS
	select IOMMU_IO_PGTABLE_LPAE
	select GENERIC_IRQ_CHIP
	select IRQ_DOMAIN_HIERARCHY
	select IRQ_FASTEOI_HIERARCHY_HANDLERS
	select SYS_HYPERVISOR
	select REGMAP_MMIO
```

## kernel_platform/soc-repo/drivers/base/regmap/Kconfig
```kconfig
# SPDX-License-Identifier: GPL-2.0
# Generic register map support.  There are no user servicable options here,
# this is an API intended to be used by other kernel subsystems.  These
# subsystems should select the appropriate symbols.

config REGMAP_QTI_DEBUGFS
	tristate "Regmap QTI debug feature support"
	depends on REGMAP && DEBUG_FS
	help
	  This library provides a runtime debugfs interface to read and write a
	  subset of regmap registers.  This interface is more performant and
	  easier to use than the traditional method which dumps all registers
	  defined in a given regmap.

config REGMAP_QTI_DEBUGFS_ALLOW_WRITE
	bool "Allow QTI regmap debugfs write"
	depends on REGMAP_QTI_DEBUGFS
	help
	  Say 'y' here to allow regmap debugfs writes within the QTI debugfs
	  regmap library.  Regmap debugfs write could be risky when accessing
	  essential hardware components, so it is not recommended to enable this
	  option on production devices.
```

## kernel_platform/soc-repo/drivers/block/Kconfig
```kconfig
# SPDX-License-Identifier: GPL-2.0
#
# Block device driver configuration
#

menu "blk dev"

config VIRTIO_BLK
	tristate "Virtio block driver"
	depends on VIRTIO
	select SG_POOL
	help
	  This is the virtual block driver for virtio.  It can be used with
	  QEMU based VMMs (like KVM or Xen).
	  Virtio block devices provide a paravirtualized interface that enables
	  efficient data transfer between the guest and host systems.
	  By enabling this driver, the guest operating system can recognize and
	  interact with block devices such as virtual hard disks offered by the
	  hypervisor through the virtio protocol.
	  Say Y or M.

config VIRTIO_BLK_QTI_CRYPTO
	tristate "Vendor specific VIRTIO Crypto Engine Support"
	depends on VIRTIO_BLK && QTI_CRYPTO_VIRTUALIZATION
	help
	 Enable storage inline crypto engine support for guest virtual machine.
	 Enabling this allows kernel to use crypto operations defined
	 and implemented by QTI.
	 Say Y or M.

endmenu
```

## kernel_platform/soc-repo/drivers/block/zram/Kconfig
```kconfig
# SPDX-License-Identifier: GPL-2.0

config ZSMALLOC_NO_ZONE_NORMAL
	bool "Prevent zsmalloc pages from being allocated from Normal zone"
	help
	  This feature, when enabled, helps prevent zsmalloc pages from being
	  allocated from the Normal zone. ZRAM ignores the min_watermark when
	  allocating memory. This presents a problem because that makes it
	  possible for zram to completely deplete the memory in a zone.
	  To prevent ZRAM from depleting the ZONE_NOMRAL memory when it fallsback,
	  this feature stops zram from allocating any memory from the normal zone.
	  if unsure, say No here.
```

## kernel_platform/soc-repo/drivers/bus/mhi/Kconfig
```kconfig
# SPDX-License-Identifier: GPL-2.0
#
# MHI bus
#
# Copyright (c) 2021, Linaro Ltd.
#

source "$(KCONFIG_EXT_PREFIX)drivers/bus/mhi/host/Kconfig"
source "$(KCONFIG_EXT_PREFIX)drivers/bus/mhi/devices/Kconfig"
```

## kernel_platform/soc-repo/drivers/char/Kconfig
```kconfig
# SPDX-License-Identifier: GPL-2.0
#
# Character device configuration
#

menu "Character devices"

config MSM_RDBG
	tristate "QTI Remote debug driver"
	help
	Implements a shared memory based transport mechanism that allows
	for a debugger running on a host PC to communicate with a remote
	stub running on peripheral subsystems such as the ADSP, MODEM etc.
		Say M if you want to enable this module.

endmenu
```
