## kernel_platform/soc-repo/drivers/irqchip/Kconfig
```kconfig
# SPDX-License-Identifier: GPL-2.0-only
menu "IRQ chip support"

config QCOM_PDC
	tristate "QCOM PDC"
	depends on ARCH_QCOM
	select IRQ_DOMAIN_HIERARCHY
	help
	  Power Domain Controller driver to manage and configure wakeup
	  IRQs for Qualcomm Technologies Inc (QTI) mobile chips.

config QCOM_SHOW_RESUME_IRQ
        tristate "Enable logging of interrupts that could have caused resume"
        depends on PM
        depends on ARM_GIC || ARM_GIC_V3
        help
          This option logs wake up interrupts that have triggered just before
          the resume loop unrolls. It helps to debug to know any unnecessary
          wake up interrupts that causes system to come out of low power modes.
          Say Y if you want to debug why the system resumed.

endmenu
```

## kernel_platform/soc-repo/drivers/leds/Kconfig
```kconfig
# SPDX-License-Identifier: GPL-2.0-only
# This library does not depend on NEW_LEDS and must be independent so it can be
# selected from other subsystems (specifically backlight).
if NEW_LEDS

comment "LED drivers"

config LEDS_QTI_FLASH
	tristate "Support for QTI Flash LEDs"
	depends on LEDS_CLASS_FLASH
	depends on MFD_SPMI_PMIC
	select LEDS_TRIGGERS
	help
	  This driver supports flash LED peripheral that is present on
	  some Qualcomm Technologies, Inc. PMICs (e.g. PM8350C).  It can
	  configure the flash LED target current for several independent
	  channels. It also supports various over current and over
	  temperature mitigation features.

	  To compile this driver as a module, choose M here: the
	  module will be called leds-qti-flash.

config LEDS_QPNP_VIBRATOR_LDO
        tristate "Vibrator-LDO support for QPNP PMIC"
        depends on LEDS_CLASS && MFD_SPMI_PMIC
        help
          This option enables device driver support for the vibrator-ldo
          peripheral found on Qualcomm Technologies, Inc. QPNP PMICs.
          The vibrator-ldo peripheral is capable of driving ERM vibrators.

          To compile this driver as a module, choose M here: the module
          will be called leds-qpnp-vibrator-ldo.

endif # NEW_LEDS
```

## kernel_platform/soc-repo/drivers/mailbox/Kconfig
```kconfig
# SPDX-License-Identifier: GPL-2.0-only

if MAILBOX

config QCOM_IPCC
	tristate "Qualcomm Technologies, Inc. IPCC driver"
	depends on ARCH_QCOM || COMPILE_TEST
	help
	  Qualcomm Technologies, Inc. Inter-Processor Communication Controller
	  (IPCC) driver for MSM devices. The driver provides mailbox support for
	  sending interrupts to the clients. On the other hand, the driver also
	  acts as an interrupt controller for receiving interrupts from clients.
	  Say Y here if you want to build this driver.

config MSM_QMP
	tristate "QTI Mailbox Protocol(QMP)"
	help
	  Say yes to add support for the QTI Mailbox Protocol mailbox driver.
	  QMP is a lightweight communication protocol for sending messages to
	  a remote processor. This protocol fits into the Generic Mailbox
	  Framework. QMP uses a mailbox located in shared memory.

endif
```

## kernel_platform/soc-repo/drivers/mmc/host/Kconfig
```kconfig
# SPDX-License-Identifier: GPL-2.0-only
#
# MMC/SD host controller drivers
#

comment "MMC/SD/SDIO Host Controller Drivers"

config MMC_SDHCI_MSM
	tristate "Qualcomm SDHCI Controller Support"
	depends on ARCH_QCOM || COMPILE_TEST
	depends on MMC_SDHCI_PLTFM
	select MMC_SDHCI_IO_ACCESSORS
	select MMC_CQHCI
	select QCOM_INLINE_CRYPTO_ENGINE if MMC_CRYPTO
	help
	  This selects the Secure Digital Host Controller Interface (SDHCI)
	  support present in Qualcomm SOCs. The controller supports
	  SD/MMC/SDIO devices.

	  If you have a controller with this interface, say Y or M here.

	  If unsure, say N.

config SDHCI_MSM_DBG
	bool "Qualcomm Technologies, Inc. SDHCI_MSM_DBG Driver"
	depends on MMC_SDHCI_MSM
	help
	  This enables the IPC tracing events for sdhci_msm driver.

	  Tracing sdhci_msm events helps to trace significant events
	  used for debugging purpose.

	  If unsure, say N here.

config MMC_CRYPTO
	bool "MMC Crypto Engine Support"
	depends on BLK_INLINE_ENCRYPTION
	help
	  Enable Crypto Engine Support in MMC.
	  Enabling this makes it possible for the kernel to use the crypto
	  capabilities of the MMC device (if present) to perform crypto
	  operations on data being transferred to/from the device.

config MMC_CRYPTO_QTI
        tristate "MMC Crypto Engine Support for QCOM Hardware Wrapped Keys"
        depends on MMC_CRYPTO && QCOM_INLINE_CRYPTO_ENGINE
        help
          Enable Crypto Engine Support in MMC for QCOM chipsets supporting
          wrapped keys. This is explicitly required until wrapped keys support
          for QCOM chipsets is part of Linux upstream.

          Select this to enable QCOM Hardware Wrapped Key support for the
          ICE hardware.
```

## kernel_platform/soc-repo/drivers/net/Kconfig
```kconfig
# SPDX-License-Identifier: GPL-2.0-only
#
# Network device configuration
#

config VIRTIO_NET
	tristate "Virtio network driver"
	depends on VIRTIO
	select NET_FAILOVER
	select DIMLIB
	help
	  Enable this option to include the VirtIO-based network driver.
	  This driver is essential for supporting VirtIO network devices,
	  commonly used in virtualization environments. It works with
	  QEMU-based virtual machine managers (e.g., KVM or Xen).
	  Say Y or M.

menuconfig NETDEVICES
	default y if UML
	depends on NET
	bool "Network device support"
	help
	  You can say N here if you don't intend to connect your Linux box to
	  any other computer at all.

	  You'll have to say Y if your computer contains a network card that
	  you want to use under Linux. If you are going to run SLIP or PPP over
	  telephone line or null modem cable you need say Y here. Connecting
	  two machines with parallel ports using PLIP needs this, as well as
	  AX.25/KISS for sending Internet traffic over amateur radio links.

	  See also "The Linux Network Administrator's Guide" by Olaf Kirch and
	  Terry Dawson. Available at <http://www.tldp.org/guides.html>.

	  If unsure, say Y.

if NETDEVICES

source "$(KCONFIG_EXT_PREFIX)drivers/net/pcs/Kconfig"
source "$(KCONFIG_EXT_PREFIX)drivers/net/ethernet/Kconfig"
source "$(KCONFIG_EXT_PREFIX)drivers/net/phy/Kconfig"

endif # NETDEVICES
```

## kernel_platform/soc-repo/drivers/net/ethernet/Kconfig
```kconfig
# SPDX-License-Identifier: GPL-2.0-only
#
# Ethernet LAN device configuration
#

menuconfig ETHERNET
	bool "Ethernet driver support"
	depends on NET
	default y
	help
	  This section contains all the Ethernet device drivers.

if ETHERNET
source "$(KCONFIG_EXT_PREFIX)drivers/net/ethernet/stmicro/Kconfig"
endif # ETHERNET
```
