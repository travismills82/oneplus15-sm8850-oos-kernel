## kernel_platform/soc-repo/init/Kconfig
```kconfig
# SPDX-License-Identifier: GPL-2.0-only
menu "General setup"

config MSM_SYSSTATS
        tristate "Export system/task statistics through netlink"
        depends on NET
        depends on MULTIUSER
        help
          Export system and task statistics through generic netlink
          interface. Userspace can retrieve these statistics via netlink
          socket.
          If unsure, say N

config MSM_SYSSTATS_STUB_NONEXPORTED_SYMBOLS
        bool "Stub out non-exported core-kernel symbols"
        depends on MSM_SYSSTATS
        help
          Stub out is_system_dmabufheap(), vmalloc_nr_pages() and si_swapinfo().
          Enabling this option will make the swap_used, swap_total and
          vmalloc_total fields of struct sysstats_mem 0, and will make the
          unreclaimable field either 0, or make it only include the KGSL memory.
          If unsure, say N.

endmenu		# General setup
```

## kernel_platform/soc-repo/kernel/trace/Kconfig
```kconfig
# SPDX-License-Identifier: GPL-2.0-only

config IPC_LOGGING
	tristate "Debug Logging for IPC Drivers"
	depends on DEBUG_FS && FTRACE
	help
	  IPC Logging driver provides a logging option for IPC Drivers.
	  This provides a cyclic buffer based logging support in a driver
	  specific context. This driver also provides a debugfs interface
	  to dump the logs in a live fashion.

	  If in doubt, say no.

config IPC_LOGGING_CDEV
	tristate "Ipc Logging Character Device"
	depends on IPC_LOGGING
	help
	  Character device for ipc logging. Reading it will extract ipc logs up to
	  the specified size and increment the read index of the ipc log buffer.
	  Read function will return EOF when there is no longer any data to read
	  in the ipc log buffer.

config IPC_LOG_MINIDUMP_BUFFERS
        int "Ipc log buffers count that can be dumped with minidump"
	depends on IPC_LOGGING
        default 0
        help
          This option is used to configure maximum number of ipc log
          buffers that can be dumped by minidump.
```

## kernel_platform/soc-repo/net/Kconfig
```kconfig
# SPDX-License-Identifier: GPL-2.0-only
#
# Network configuration
#

if NET

menu "Networking options"

source "$(KCONFIG_EXT_PREFIX)net/qrtr/Kconfig"
source "$(KCONFIG_EXT_PREFIX)net/qmsgq/Kconfig"

endmenu

endif   # if NET
```

## kernel_platform/soc-repo/sound/usb/Kconfig
```kconfig
# SPDX-License-Identifier: GPL-2.0-only
# ALSA USB drivers

if SND_USB && USB

config SND_USB_AUDIO_QMI
	tristate "USB Audio QMI Service driver"
	depends on QCOM_QMI_HELPERS && SND_USB_AUDIO
	help
	  Starts USB Audio QMI server to communicate with remote entity
	  to perform operations like enable or disable particular audio
	  stream on a connected USB device, subsystem restart and
	  device disconnect.

endif	# SND_USB
```

## vendor/oplus/kernel/cpu/cpufreq_bouncing/Kconfig
```kconfig
config OPLUS_FEATURE_GKI_CPUFREQ_BOUNCING
	tristate "cpufreq_bouncing"
	default n
	help
	  adjust cpu max frequency based on cpu busy duration

config OPLUS_FEATURE_CEILING_FREE
	tristate "ceiling free"
	default n
	help
		set cb/omrg max frequency to default when user touch screen.

config OPLUS_FEATURE_CPU_QOS_ARBITER
	tristate "Integrate qos requests"
	default n
	help
		Integrate qos requests
```

## vendor/oplus/kernel/cpu/freq_qos_arbiter/Kconfig
```kconfig
# SPDX-License-Identifier: GPL-2.0-only
# Copyright (C) 2018-2020 Oplus. All rights reserved.

config OPLUS_FEATURE_CPU_QOS_ARBITER
    tristate "Integrate qos requests"
    default n
    help
        Integrate qos requests
```

## vendor/oplus/kernel/cpu/geas/cpu/Kconfig
```kconfig
config OPLUS_FEATURE_GEAS_CPU
        tristate "geas cpu"
        default n
        help
          turning for game
```

## vendor/oplus/kernel/cpu/geas/system/Kconfig
```kconfig
config OPLUS_FEATURE_GEAS
        tristate "geas"
        default n
        help
          turning for game

config OPLUS_FEATURE_GEAS_EMI
        tristate "geas cpu"
        depends on OPLUS_FEATURE_GEAS
        default n
        help
          turning for game

config OPLUS_FEATURE_GEAS_FDRIVE
        tristate "geas frame drive"
        depends on OPLUS_FEATURE_GEAS
        default n
        help
          turning for game

config OPLUS_FEATURE_GEAS_BWMON
        tristate "geas bwmon"
        depends on OPLUS_FEATURE_GEAS
        default n
        help
          turning for game

config OPLUS_FEATURE_GEAS_GPU
        tristate "geas gpu"
        depends on OPLUS_FEATURE_GEAS
        default n
        help
          turning for game

config OPLUS_FEATURE_GEAS_MEMLAT
        tristate "geas memlat"
        depends on OPLUS_FEATURE_GEAS
        default n
        help
          turning for game

config OPLUS_FEATURE_GEAS_NPU
        tristate "geas emi"
        depends on OPLUS_FEATURE_GEAS
        default n
        help
          turning for game
```

## vendor/oplus/kernel/cpu/oplus_omrg/Kconfig
```kconfig
config OPLUS_OMRG
  tristate "oplus multiple rail group"
  default n
  help
    manager frequency dependency caused by multiple rail between
    different cpufreq device and devfreq device

config OPLUS_FEATURE_CPU_QOS_ARBITER
	tristate "Integrate qos requests"
	default n
	help
		Integrate qos requests
```

## vendor/oplus/kernel/mm/aizerofs/Kconfig
```kconfig
config OPLUS_FEATURE_AIZEROCOPY
	tristate "AI zero copy"
	select DMA_SHARED_BUFFER
	default n
	help
	  Enable AI zero copy

config AIZEROFS_DEBUG_SYS_ABI
	bool "aizerofs sysfs debug abi"
	depends on OPLUS_FEATURE_AIZEROCOPY
	default y
	help
	  support aizerofs sysfs debug
```

## vendor/qcom/opensource/bt-kernel/threadpower/Kconfig
```kconfig
# SPDX-License-Identifier: GPL-2.0-only

config CONFIG_MSM_THREAD_POWER
	tristate "MSM Thread Power Control"
	depends on ARCH_QCOM
	help
		MSM Thread Power control driver.
		This provides a parameter to switch on/off power from PMIC
		to Thread device. This will control LDOs/Clock/GPIOs to
		control Thread Chipset based on power on/off sequence.

		Say Y here to compile support for Thread Power driver
		into the kernel or say M to compile as a module.
```
