## kernel_platform/soc-repo/drivers/net/phy/Kconfig
```kconfig
# SPDX-License-Identifier: GPL-2.0-only
#
# PHY Layer Configuration
#

source "$(KCONFIG_EXT_PREFIX)drivers/net/phy/aquantia/Kconfig"
```

## kernel_platform/soc-repo/drivers/pci/controller/Kconfig
```kconfig
# SPDX-License-Identifier: GPL-2.0

menu "PCI controller drivers"
	depends on PCI

config PCI_MSM
	tristate "MSM PCIe Controller driver"
	depends on ARCH_QCOM && PCI
	depends on PCI_DOMAINS
	depends on PCI_DOMAINS_GENERIC
	depends on PCI_MSI
	depends on CRC8
	depends on PCI_ECAM
	help
	  Enables the PCIe functionality by configuring PCIe core on
	  MSM chipset and by enabling the ARM PCI framework extension.
	  The PCIe core is essential for communication between the host
	  and an endpoint.

	  If unsure, say N.

config PCIE_QCOM_ECAM
	tristate "QCOM PCIe ECAM host controller"
	depends on ARCH_QCOM && PCI
	depends on OF
	select PCI_MSI
	select PCI_HOST_COMMON
	select IRQ_DOMAIN
	help
	  Say Y here if you want to use ECAM shift mode compatible PCIe
	  root host controller. The controller is programmed using firmware
	  to support ECAM compatible memory address space.

	  If unsure, say N.

endmenu
```

## kernel_platform/soc-repo/drivers/pinctrl/qcom/Kconfig.msm
```kconfig
# SPDX-License-Identifier: GPL-2.0-only
if PINCTRL_MSM

config PINCTRL_CANOE
	tristate "Qualcomm Technologies, Inc. CANOE pin controller driver"
	depends on GPIOLIB && OF
	help
	  This is the pinctrl, pinmux, pinconf and gpiolib driver for the
	  Qualcomm Technologies Inc Top Level Mode Multiplexer block (TLMM)
	  block found on the Qualcomm Technologies Inc CANOE platform.
	  Say Y here to compile statically, or M here to compile it as a
	  module. If unsure, say N.

config PINCTRL_ALOR
	tristate "Qualcomm Technologies, Inc. Alor pin controller driver"
	depends on GPIOLIB && OF
	help
	  This is the pinctrl, pinmux, pinconf and gpiolib driver for the
	  Qualcomm Technologies Inc Top Level Mode Multiplexer block (TLMM)
	  block found on the Qualcomm Technologies Inc Alor platform.
	  Say Y here to compile statically, or M here to compile it as a
	  module. If unsure, say N.

config PINCTRL_CHORA
	tristate "Qualcomm Technologies, Inc. Chora pin controller driver"
	depends on GPIOLIB && OF
	help
	  This is the pinctrl, pinmux, pinconf and gpiolib driver for the
	  Qualcomm Technologies Inc Top Level Mode Multiplexer block (TLMM)
	  block found on the Qualcomm Technologies Inc Chora platform.
	  Say Y here to compile statically, or M here to compile it as a
	  module. If unsure, say N.

config PINCTRL_SUN
	tristate "Qualcomm Technologies, Inc. SUN pin controller driver"
	depends on GPIOLIB && OF
	help
	  This is the pinctrl, pinmux, pinconf and gpiolib driver for the
	  Qualcomm Technologies Inc Top Level Mode Multiplexer block (TLMM)
	  block found on the Qualcomm Technologies Inc SUN platform.
	  Say Y here to compile statically, or M here to compile it as a
	  module. If unsure, say N.

config PINCTRL_VIENNA
	tristate "Qualcomm Technologies, Inc. VIENNA pin controller driver"
	depends on GPIOLIB && OF
	help
	  This is the pinctrl, pinmux, pinconf and gpiolib driver for the
	  Qualcomm Technologies Inc Top Level Mode Multiplexer block (TLMM)
	  block found on the Qualcomm Technologies Inc VIENNA platform.
	  Say Y here to compile statically, or M here to compile it as a
	  module. If unsure, say N.

config PINCTRL_PINEAPPLE
	tristate "Qualcomm Technologies, Inc. Pineapple pin controller driver"
	depends on GPIOLIB && OF
	help
	  This is the pinctrl, pinmux, pinconf and gpiolib driver for the
	  Qualcomm Technologies Inc Top Level Mode Multiplexer block (TLMM)
	  block found on the Qualcomm Technologies Inc PINEAPPLE platform.
	  Say Y here to compile statically, or M here to compile it as a
	  module. If unsure, say N.

config PINCTRL_X1E80100
	tristate "Qualcomm Technologies Inc X1E80100 pin controller driver"
	depends on GPIOLIB && OF
	help
	  This is the pinctrl, pinmux, pinconf and gpiolib driver for the
	  Qualcomm Technologies Inc Top Level Mode Multiplexer block (TLMM)
	  block found on the Qualcomm Technologies Inc X1E80100 platform.
	  Say Y here to compile statically, or M here to compile it as a module.
	  If unsure, say N.

config PINCTRL_YUPIK
	tristate "Qualcomm Technologies Inc YUPIK pin controller driver"
	depends on GPIOLIB && OF
	help
	  This is the pinctrl, pinmux, pinconf and gpiolib driver for the
	  Qualcomm Technologies Inc Top Level Mode Multiplexer block (TLMM)
	  block found on the Qualcomm Technologies Inc YUPIK platform.
	  Say Y here to compile statically, or M here to compile it as a module.
	  If unsure, say N.

endif
```

## kernel_platform/soc-repo/drivers/power/supply/Kconfig
```kconfig
# SPDX-License-Identifier: GPL-2.0-only
if POWER_SUPPLY

config QTI_BATTERY_CHARGER
	tristate "QTI Glink battery charger"
	depends on QTI_PMIC_GLINK
	help
	  Say Y here to enable Qualcomm Technologies, Inc. battery charger
	  driver which interfaces with the charger firmware running on the
	  remote subsystem (e.g. DSP) by communicating over PMIC Glink channel
	  and provides information about the battery, USB and wireless charging
	  by exposing them as power supply devices.

	  To compile the driver as a module, choose M here: the module will be
	  called qti_battery_charger.

config CHARGER_QCOM_SMBB
	tristate "Qualcomm Switch-Mode Battery Charger and Boost"
	depends on MFD_SPMI_PMIC || COMPILE_TEST
	depends on OF
	depends on EXTCON
	depends on REGULATOR
	help
	  Say Y to include support for the Switch-Mode Battery Charger and
	  Boost (SMBB) hardware found in Qualcomm PM8941 PMICs.  The charger
	  is an integrated, single-cell lithium-ion battery charger.  DT
	  configuration is required for loading, see the devicetree
	  documentation for more detail.  The base name for this driver is
	  'pm8941_charger'.

endif # POWER_SUPPLY
```

## kernel_platform/soc-repo/drivers/spi/Kconfig
```kconfig
# SPDX-License-Identifier: GPL-2.0-only
#
# SPI driver configuration
#

if SPI

#
# MASTER side ... talking to discrete SPI slave chips including microcontrollers
#

if SPI_MASTER

comment "SPI Master Controller Drivers"

config Q2SPI_MSM_GENI
	tristate "Qualcomm Technologies Inc.'s GENI based Q2SPI controller"
	depends on QCOM_GENI_SE
	depends on MSM_GPI_DMA
	help
	  This driver supports GENI serial engine based Q2SPI controller in
	  master mode on the Qualcomm Technologies Inc.'s SoCs. If you say
	  yes to this option, support will be included for the built-in Q2SPI
	  interface on the Qualcomm Technologies Inc.'s SoCs.

	  This driver can also be built as a module.  If so, the module
	  will be called q2spi-geni.

config SPI_MSM_GENI
	tristate "Qualcomm Technologies Inc.'s GENI based SPI controller"
	depends on QCOM_GENI_SE
	help
	  This driver supports GENI serial engine based SPI controller in
	  master mode on the Qualcomm Technologies Inc.'s SoCs. If you say
	  yes to this option, support will be included for the built-in SPI
	  interface on the Qualcomm Technologies Inc.'s SoCs.

	  This driver can also be built as a module.  If so, the module
	  will be called spi-msm-geni.

config SPI_QCOM_GENI
	tristate "Qualcomm GENI based SPI controller"
	depends on QCOM_GENI_SE
	help
	  This driver supports GENI serial engine based SPI controller in
	  master mode on the Qualcomm Technologies Inc.'s SoCs. If you say
	  yes to this option, support will be included for the built-in SPI
	  interface on the Qualcomm Technologies Inc.'s SoCs.

	  This driver can also be built as a module.  If so, the module
	  will be called spi-geni-qcom.

config SPI_QCOM_GENI_MSM
	tristate "Qualcomm Technologies Inc.'s GENI based SPI controller with SCMI"
	depends on QCOM_GENI_SE_MSM
	help
	  This driver supports GENI serial engine based SPI controller in
	  master mode on the Qualcomm Technologies Inc.'s SoCs. If you say
	  yes to this option, support will be included for the built-in SPI
	  interface on the Qualcomm Technologies Inc.'s SoCs.

	  This driver can also be built as a module.  If so, the module
	  will be called spi-geni-qcom-msm.

endif # SPI_MASTER

endif # SPI
```

## kernel_platform/soc-repo/drivers/spmi/Kconfig
```kconfig
# SPDX-License-Identifier: GPL-2.0-only
#
# SPMI driver configuration
#
if SPMI

config SPMI_MSM_PMIC_ARB
	tristate "Qualcomm MSM SPMI Controller (PMIC Arbiter)"
	select IRQ_DOMAIN_HIERARCHY
	depends on ARCH_QCOM || COMPILE_TEST
	depends on HAS_IOMEM
	default ARCH_QCOM
	help
	  If you say yes to this option, support will be included for the
	  built-in SPMI PMIC Arbiter interface on Qualcomm MSM family
	  processors.

	  This is required for communicating with Qualcomm PMICs and
	  other devices that have the SPMI interface.

config SPMI_MSM_PMIC_ARB_DEBUG
	tristate "QTI SPMI Debug Controller (PMIC Arbiter)"
	depends on ARCH_QCOM || COMPILE_TEST
	depends on HAS_IOMEM
	help
	  If you say yes to this option, support will be included for the
	  built-in SPMI PMIC Arbiter debug interface on Qualcomm Technologies,
	  Inc. (QTI) MSM family processors.  This feature is available on chips
	  with PMIC arbiter version 5 and above.

config VIOSPMI_MSM_PMIC_ARB
	tristate "QTI Virtio SPMI Controller (Virtio PMIC Arbiter)"
	select IRQ_DOMAIN
	depends on ARCH_QCOM || COMPILE_TEST
	depends on HAS_IOMEM
	depends on VIRTIO
	help
	  If you say yes to this option, support will be included for the
	  built-in SPMI PMIC Arbiter interface on MSM virtual platform.

	  This is required for communicating with PMICs and
	  other devices that have the SPMI interface.

endif
```

## kernel_platform/soc-repo/drivers/tty/hvc/Kconfig
```kconfig
# SPDX-License-Identifier: GPL-2.0

config HVC_GUNYAH
	  tristate "Gunyah tty support"
	  depends on GH_RM_DRV
	  select HVC_DRIVER
	  help
	  This console exposes communication with other
	  virtual machines in the Gunyah hypervisor. This
	  option may also be used as an early console
	  to another VM.

config HVC_GUNYAH_CONSOLE
	  bool "Gunyah console support"
	  depends on HVC_GUNYAH
	  help
	  Select this option to allow Gunyah tty
	  as an boot console communicating with
	  the primary VM. Still need to specify
	  earlycon and console parameters.
```

## kernel_platform/soc-repo/drivers/uio/Kconfig
```kconfig
# SPDX-License-Identifier: GPL-2.0-only
menuconfig UIO
	tristate "Userspace I/O drivers"
	depends on MMU
	help
	  Enable this to allow the userspace driver core code to be
	  built.  This code allows userspace programs easy access to
	  kernel interrupts and memory locations, allowing some drivers
	  to be written in userspace.  Note that a small kernel driver
	  is also required for interrupt handling to work properly.

	  If you don't know what to do here, say N.

if UIO

config UIO_MSM_SHAREDMEM
	tristate "MSM shared memory driver"
	default n
	help
	  Provides the clients with their respective alloted shared memory
	  addresses which are used as transport buffer.

	  If you don't know what to do here, say N.

endif
```

## kernel_platform/soc-repo/drivers/usb/dwc3/Kconfig
```kconfig
# SPDX-License-Identifier: GPL-2.0

if USB_DWC3

comment "Platform Glue Driver Support"

config USB_DWC3_MSM
	tristate "QTI MSM Platforms"
	depends on ARCH_QCOM || COMPILE_TEST
	help
	  Applicable to QTI MSM Platforms with DesignWare Core
	  USB3 IP.
	  Driver supports host, device and dual-role modes of operation.
	  Say 'Y' or 'M' if you have one such device.

endif
```

## kernel_platform/soc-repo/drivers/usb/phy/Kconfig
```kconfig
# SPDX-License-Identifier: GPL-2.0
#
# Physical Layer USB driver configuration
#
menu "USB Physical Layer drivers"

#
# USB Transceiver Drivers
#
config NOP_USB_XCEIV
	tristate "NOP USB Transceiver Driver"
	depends on USB_GADGET || !USB_GADGET # if USB_GADGET=m, NOP can't be built-in
	select USB_PHY
	help
	  This driver is to be used by all the usb transceiver which are either
	  built-in with usb ip or which are autonomous and doesn't require any
	  phy programming such as ISP1x04 etc.

config USB_QCOM_EMU_PHY
	tristate "Qualcomm Technologies, Inc. emulation USB PHY driver"
	depends on ARCH_QCOM || COMPILE_TEST
	select USB_PHY
	help
	  Enable this to support the USB transceiver used on
	  Qualcomm Technologies, Inc. emulation platforms. It simply performs
	  PHY initialization given a basic register write sequence.

	  To compile this driver as a module, choose M here: the
	  module will be called phy-qcom-emu.

config USB_MSM_SSPHY_QMP
	tristate "MSM SSUSB QMP PHY Driver"
	depends on ARCH_QCOM || COMPILE_TEST
	select USB_PHY
	help
	  Enable this to support the SuperSpeed USB transceiver on MSM chips.
	  This driver supports the PHY which uses the QSCRATCH-based register
	  set for its control sequences, normally paired with newer DWC3-based
	  SuperSpeed controllers.

config MSM_QUSB_PHY
	tristate "MSM QUSB2 PHY Driver"
	depends on ARCH_QCOM
	select USB_PHY
	help
	 Enable this to support the QUSB2 PHY on MSM chips. This driver supports
	 the high-speed PHY which is usually paired with either the ChipIdea or
	 Synopsys DWC3 USB IPs on MSM SOCs. This driver expects to configure the
	 PHY with a dedicated register I/O memory region.

config MSM_HSUSB_PHY
	tristate "MSM HSUSB PHY Driver"
	depends on ARCH_QCOM || COMPILE_TEST
	select USB_PHY
	help
	  Enable this to support the HSUSB PHY on MSM chips. This driver supports
	  the high-speed PHY which is usually paired with either the ChipIdea or
	  Synopsys DWC3 USB IPs on MSM SOCs. This driver expects to configure the
	  PHY with a dedicated register I/O memory region.

config USB_MSM_EUSB2_PHY
	tristate "MSM EUSB2 PHY Driver"
	depends on ARCH_QCOM || COMPILE_TEST
	select USB_PHY
	help
	  Enable this to support the USB EUSB2 PHY on MSM chips. This driver
	  supports reset and initialization sequence, and also perform required
	  set of operations with used repeater for USB HS/FS/LS functionality.

	  To compile this driver as a module, choose M here.

config USB_M31_MSM_EUSB2_PHY
	tristate "M31 MSM EUSB2 PHY Driver"
	depends on ARCH_QCOM || COMPILE_TEST
	select USB_PHY
	help
	  Enable this to support the M31 EUSB2 PHY on MSM chips. This driver
	  supports reset and initialization sequence, and also perform required
	  set of operations with used repeater for USB HS/FS/LS functionality.

	  To compile this driver as a module, choose M here.

endmenu
```

## kernel_platform/soc-repo/drivers/usb/typec/ucsi/Kconfig
```kconfig
# SPDX-License-Identifier: GPL-2.0

if TYPEC_UCSI

config UCSI_QTI_GLINK
	tristate "UCSI Interface Driver for QTI PMIC"
	depends on QTI_PMIC_GLINK
	help
	  This driver enables UCSI support on Qualcomm Technologies, Inc.
	  platforms that expose UCSI interface to communicate with PPM which is
	  charger firmware running on the remote subsystem (e.g. DSP) over PMIC
	  Glink.

	  To compile the driver as a module, choose M here: the module will be
	  called ucsi_qti_glink.

endif
```

## kernel_platform/soc-repo/drivers/video/Kconfig
```kconfig
# SPDX-License-Identifier: GPL-2.0
#
# Video configuration
#

source "$(KCONFIG_EXT_PREFIX)drivers/video/backlight/Kconfig"
```

## kernel_platform/soc-repo/drivers/video/backlight/Kconfig
```kconfig
# SPDX-License-Identifier: GPL-2.0
#
# Backlight & LCD drivers configuration
#

menu "Backlight & LCD device support"

#
#
# Backlight
#

config BACKLIGHT_QCOM_SPMI_WLED
        tristate "Qualcomm Technologies, Inc. WLED Driver"
        select REGMAP
        help
          If you have the Qualcomm Technologies, Inc. WLED used for backlight
          control, say Y to enable a driver for the  WLED block. This driver
          provides the interface to the display driver to adjust the brightness
          of the display backlight. This supports PMI8998, PM8150L, PM6150L
          currently.

endmenu
```

## kernel_platform/soc-repo/drivers/virt/Kconfig
```kconfig
# SPDX-License-Identifier: GPL-2.0-only
#
# Virtualization support drivers
#

if VIRT_DRIVERS

source "$(KCONFIG_EXT_PREFIX)drivers/virt/gunyah/Kconfig"

endif
```
