/dts-v1/;
/plugin/;

#include "alor-dsp.dtsi"

/ {
	model = "Qualcomm Technologies, Inc. alor v1 SoC";
	compatible = "qcom,alor";
	qcom,msm-id = <0x2AD 0x10000>, <0x10002AD 0x10000>,
			<0x2D7 0x10000>, <0x10002D7 0x10000>;
	qcom,board-id = <0 0>;
};