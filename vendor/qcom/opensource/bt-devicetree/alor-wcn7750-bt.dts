// SPDX-License-Identifier: BSD-3-Clause
/*
 * Copyright (c) Qualcomm Technologies, Inc. and/or its subsidiaries.
 */

/dts-v1/;
/plugin/;

#include "alor-wcn7750-bt.dtsi"

/ {
	model = "Qualcomm Technologies, Inc. Alor MTP + WCN7750 WLAN + PM7750BA SMB1500 + ST54L + Panderio";
	compatible = "qcom,alor-cdp", "qcom,cdp", "qcom,alor-mtp", "qcom,alor", "qcom,mtp",
		     "qcom,alor-rcm", "qcom,rcm", "qcom,alor-qrd", "qcom,qrd";
	qcom,msm-id = <685 0x10000>, <727 0x10000>;
	qcom,board-id = <0x10001 0>,<0x10008 0>,<0x20008 0>,<0x10015 0>,<0x1000B 0>,<0x1010B 0>;
};
