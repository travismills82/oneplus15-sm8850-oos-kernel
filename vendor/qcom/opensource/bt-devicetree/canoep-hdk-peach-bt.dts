// SPDX-License-Identifier: BSD-3-Clause

/*
 * Copyright (c) Qualcomm Technologies, Inc. and/or its subsidiaries.
 */

/dts-v1/;
/plugin/;

#include "canoep-hdk-peach-bt.dtsi"

/ {
	model = "Qualcomm Technologies, Inc. CanoeP HDK";
	compatible = "qcom,canoep", "qcom,canoe-hdk", "qcom,hdk";
	qcom,msm-id = <660 0x10000>, <660 0x20000>, <661 0x10000>, <661 0x20000>,
			<704 0x10000>,<704 0x20000>, <0x1000294 0x10000>, <0x1000294 0x20000>,
			<0x1000295 0x10000>, <0x1000295 0x20000>, <0x10002C0 0x10000>, <0x10002C0 0x20000>;
	qcom,board-id = <0x1001F 0>;
};
