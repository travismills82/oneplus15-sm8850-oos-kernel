// SPDX-License-Identifier: BSD-3-Clause
/*
 * Copyright (c) Qualcomm Technologies, Inc. and/or its subsidiaries.
 */

#include <dt-bindings/interrupt-controller/arm-gic.h>
#include <dt-bindings/mailbox/qcom-ipcc-canoe.h>
#include <dt-bindings/mailbox/qcom-ipcc.h>

&soc {
	msm_hfi_core: qcom,hfi-core {
		compatible = "qcom,msm-hfi-core";
		status = "ok";

		/* MBOX properties */
		mboxes = <&ipcc_mproc IPCC_MPROC_DCP 5>,
				<&ipcc_mproc IPCC_MPROC_DCP 6>,
				<&ipcc_mproc IPCC_MPROC_APSS 5>,
				<&ipcc_mproc IPCC_MPROC_APSS 6>;
		interrupt-parent = <&ipcc_mproc>;
		interrupts = <IPCC_MPROC_DCP 5 IRQ_TYPE_EDGE_RISING>,
				<IPCC_MPROC_DCP 6 IRQ_TYPE_EDGE_RISING>,
				<IPCC_MPROC_APSS 5 IRQ_TYPE_EDGE_RISING>,
				<IPCC_MPROC_APSS 6 IRQ_TYPE_EDGE_RISING>;

		/* DCP properties */
		iommus = <&apps_smmu 0x19A3 0x0>;
		dma-coherent;

		/* page 1 */
		reg = <0x0 0x9cb1000 0x0 0x1000>;
		reg-names = "swi_dev0";

		/* firmware map start addr and max size */
		qcom,device-map-addr-reg = <0x88000000 0x8000000>;
	};
};
