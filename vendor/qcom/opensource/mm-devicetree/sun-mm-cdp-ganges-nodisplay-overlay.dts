// SPDX-License-Identifier: BSD-3-Clause
/*
 * Copyright (c) Qualcomm Technologies, Inc. and/or its subsidiaries.
 */

/dts-v1/;
/plugin/;

#include "hw_fence/sun-hw-fence.dtsi"

/ {
	model = "Qualcomm Technologies, Inc. Sun CDP No Display";
	compatible = "qcom,sun-cdp", "qcom,sun", "qcom,cdp";
	qcom,msm-id = <618 0x10000>, <618 0x20000>, <639 0x10000>, <639 0x20000>;
	qcom,board-id = <0x30001 0>;
};
