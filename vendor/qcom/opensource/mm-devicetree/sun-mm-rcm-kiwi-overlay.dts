// SPDX-License-Identifier: BSD-3-Clause
/*
 * Copyright (c) Qualcomm Technologies, Inc. and/or its subsidiaries.
 */

/dts-v1/;
/plugin/;

#include "hw_fence/sun-hw-fence.dtsi"

/ {
	model = "Qualcomm Technologies, Inc. Sun RCM Kiwi WLAN";
	compatible = "qcom,sun-rcm", "qcom,sun", "qcom,sunp-rcm", "qcom,sunp", "qcom,rcm";
	qcom,msm-id = <618 0x10000>, <618 0x20000>, <0x100026a 0x10000>, <0x100026a 0x20000>,
		      <705 0x10000>, <705 0x20000>, <0x10002c1 0x10000>, <0x10002c1 0x20000>,
		      <706 0x10000>, <706 0x20000>, <0x10002c2 0x10000>, <0x10002c2 0x20000>;
	qcom,board-id = <0x40015 0>;
};
