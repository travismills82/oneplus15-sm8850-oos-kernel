// SPDX-License-Identifier: BSD-3-Clause
/*
 * Copyright (c) Qualcomm Technologies, Inc. and/or its subsidiaries.
 */

/dts-v1/;
/plugin/;

#include "hw_fence/seraph-hw-fence.dtsi"

/ {
	model = "Qualcomm Technologies, Inc. Seraph RUMI";
	compatible = "qcom,seraph-rumi", "qcom,seraph", "qcom,rumi";
	qcom,msm-id = <672 0x10000>;
	qcom,board-id = <15 0>;
};
