// SPDX-License-Identifier: BSD-3-Clause
/*
 * Copyright (c) Qualcomm Technologies, Inc. and/or its subsidiaries.
 */

/dts-v1/;
/plugin/;

#include "hw_fence/sun-hw-fence.dtsi"

/ {
	model = "Qualcomm Technologies, Inc. Sun RUMI";
	compatible = "qcom,sun-rumi", "qcom,sun", "qcom,rumi";
	qcom,msm-id = <618 0x10000>;
	qcom,board-id = <15 0>;
};
