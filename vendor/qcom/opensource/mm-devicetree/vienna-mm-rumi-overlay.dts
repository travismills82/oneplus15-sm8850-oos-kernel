// SPDX-License-Identifier: BSD-3-Clause
/*
 * Copyright (c) Qualcomm Technologies, Inc. and/or its subsidiaries.
 */

/dts-v1/;
/plugin/;

#include "hfi_core/vienna-hfi-core.dtsi"

/ {
	model = "Qualcomm Technologies, Inc. Vienna RUMI";
	compatible = "qcom,vienna-rumi", "qcom,vienna", "qcom,rumi";
	qcom,msm-id = <669 0x10000>, <670 0x10000>;
	qcom,board-id = <15 0>;
};
