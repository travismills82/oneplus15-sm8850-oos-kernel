// SPDX-License-Identifier: BSD-3-Clause
/*
 * Copyright (c) Qualcomm Technologies, Inc. and/or its subsidiaries.
 */

/dts-v1/;
/plugin/;

#include "hw_fence/seraph-hw-fence.dtsi"

/ {
	model = "Qualcomm Technologies, Inc. Seraph IDP NO DISPLAY";
	compatible = "qcom,seraph-idp", "qcom,seraph", "qcom,idp";
	qcom,msm-id = <672 0x10000>, <673 0x10000>;
	qcom,board-id = <0x10022 2>;
};
