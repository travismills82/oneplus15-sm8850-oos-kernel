/dts-v1/;
/plugin/;

#include <dt-bindings/interrupt-controller/arm-gic.h>
#include <dt-bindings/clock/qcom,gcc-niobe.h>
#include <dt-bindings/interconnect/qcom,niobe.h>
#include <dt-bindings/clock/qcom,videocc-niobe.h>
#include "niobe-vidc.dtsi"

/ {
	model = "Qualcomm Technologies, Inc. Niobe";
	compatible = "qcom,niobe", "qcom,niobep";
	qcom,msm-id = <629 0x10000>, <652 0x10000>;
	qcom,board-id = <0 0>, <0x10021 0x0>, <0x10022 0x0>, <0x10022 0x1>, <0x10026 0x0>;
};
