// SPDX-License-Identifier: BSD-3-Clause
/*
 * Copyright (c) 2024 Qualcomm Innovation Center, Inc. All rights reserved.
 */

/dts-v1/;
/plugin/;

#include <dt-bindings/interrupt-controller/arm-gic.h>
#include <dt-bindings/clock/qcom,gcc-seraph.h>
#include <dt-bindings/interconnect/qcom,seraph.h>
#include <dt-bindings/clock/qcom,videocc-seraph.h>
#include "seraph-vidc.dtsi"

/ {
	model = "Qualcomm Technologies, Inc. Seraph";
	compatible = "qcom,seraph";
	qcom,msm-id = <672 0x10000>;
	qcom,board-id = <0 0>, <15 0>;
};
