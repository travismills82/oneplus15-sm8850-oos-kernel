// SPDX-License-Identifier: BSD-3-Clause
/*
 * Copyright (c) Qualcomm Technologies, Inc. and/or its subsidiaries.
 */

/dts-v1/;
/plugin/;

#include <dt-bindings/interrupt-controller/arm-gic.h>
#include <dt-bindings/soc/qcom,ipcc.h>
#include <dt-bindings/interconnect/qcom,alor.h>
#include <dt-bindings/clock/qcom,alor-gcc.h>
#include <dt-bindings/clock/qcom,rpmh.h>
#include "canoe-ipa.dtsi"

/ {
	model = "Qualcomm Technologies, Inc. Alor Interposer";
	compatible = "qcom,alor";
	qcom,msm-id = <685 0x10000>;
	qcom,board-id = <0 0>;
};