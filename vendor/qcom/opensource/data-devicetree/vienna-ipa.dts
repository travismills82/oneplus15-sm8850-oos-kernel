// SPDX-License-Identifier: BSD-3-Clause
/*
 * Copyright (c) 2025 Qualcomm Innovation Center, Inc. All rights reserved.
 */

/dts-v1/;
/plugin/;

#include <dt-bindings/interrupt-controller/arm-gic.h>
#include <dt-bindings/soc/qcom,ipcc.h>
#include <dt-bindings/interconnect/qcom,vienna.h>
#include <dt-bindings/clock/qcom,gcc-vienna.h>
#include <dt-bindings/clock/qcom,rpmh.h>
#include "vienna-ipa.dtsi"

/ {
	model = "Qualcomm Technologies, Inc. Vienna SoC";
	compatible = "qcom,vienna";
	qcom,msm-id = <669 0x10000>;
	qcom,board-id = <0 0>;
};
