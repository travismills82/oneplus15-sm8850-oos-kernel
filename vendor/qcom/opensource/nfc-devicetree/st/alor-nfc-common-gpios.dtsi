// SPDX-License-Identifier: BSD-3-Clause

/*
 * Copyright (c) Qualcomm Technologies, Inc. and/or its subsidiaries.
 */
#include "alor-nfc-pinctrl.dtsi"

&qupv3_se0_i2c {
        status = "ok";
        qcom,clk-freq-out = <1000000>;
        #address-cells = <1>;
        #size-cells = <0>;
        st21nfc: st21nfc@08 {
                compatible = "st,st21nfc";
                reg = <0x08>;
                irq-gpios = <&tlmm 47 0x00>;
                reset-gpios = <&tlmm 34 0x00>;
                clkreq-gpios = <&tlmm 35 0x00>;
                interrupt-parent = <&tlmm>;
                nvmem-cells = <&bob1_off_mode_enable>;
                nvmem-cell-names = "nfc_bob1_cell";
                interrupts = <47 0>;
                interrupt-names = "nfc_irq";
                pinctrl-names = "nfc_active", "nfc_suspend";
                pinctrl-0 = <&nfc_int_active &nfc_enable_active>;
                pinctrl-1 = <&nfc_int_suspend &nfc_enable_suspend>;
        };
};
