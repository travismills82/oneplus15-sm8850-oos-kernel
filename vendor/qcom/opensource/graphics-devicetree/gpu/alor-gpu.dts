// SPDX-License-Identifier: BSD-3-Clause
/*
 * Copyright (c) Qualcomm Technologies, Inc. and/or its subsidiaries.
 */

/dts-v1/;
/plugin/;

#include <dt-bindings/clock/qcom,alor-gcc.h>
#include <dt-bindings/clock/qcom,aop-qmp.h>
#include <dt-bindings/clock/qcom,gpucc-canoe.h>
#include <dt-bindings/clock/qcom,gxclkctl-canoe.h>
#include <dt-bindings/clock/qcom,rpmh.h>
#include <dt-bindings/interconnect/qcom,alor.h>
#include <dt-bindings/interrupt-controller/arm-gic.h>
#include <dt-bindings/regulator/qcom,rpmh-regulator-levels.h>

#include "alor-gpu.dtsi"
#include "alor-gpu-pwrlevels.dtsi"

/ {
	model = "Qualcomm Technologies, Inc. Alor SoC";
	compatible = "qcom,alor";
	qcom,msm-id = <0x2ad 0x10000>;
	qcom,board-id = <0 0>;
};
