// SPDX-License-Identifier: BSD-3-Clause
/*
 * Copyright (c) 2025 Qualcomm Innovation Center, Inc. All rights reserved.
 */

/dts-v1/;
/plugin/;

#include "canoe-audio-mtp-wsa885x.dtsi"
/ {
	model =	"Qualcomm Technologies, Inc. Alor Interposer SoC";
	compatible = "qcom,canoe-mtp", "qcom,canoe", "qcom,mtp";
	qcom,msm-id = <704 0x10000>, <704 0x20000>,
			<0x10002C0 0x10000>, <0x10002C0 0x20000>;
	qcom,board-id = <8 0>;
};
