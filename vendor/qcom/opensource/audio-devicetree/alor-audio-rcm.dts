//
/* Copyright (c) Qualcomm Technologies, Inc. and/or its subsidiaries.
 *  SPDX-License-Identifier: BSD-3-Clause-Clear
 */

/dts-v1/;
/plugin/;

#include "alor-audio-cdp.dtsi"

/ {
	model = "Qualcomm Technologies, Inc. Alor RCM ";
	compatible = "qcom,alor-rcm", "qcom,alor", "qcom,rcm", "qcom,alorp-rcm", "qcom,alorp";
	qcom,msm-id = <685 0x10000>, <727 0x10000>;
	qcom,board-id = <0x10015 0>, <0x20015 0>;
};
