//
/* Copyright (c) Qualcomm Technologies, Inc. and/or its subsidiaries.
 * SPDX-License-Identifier: BSD-3-Clause
 */

/dts-v1/;
/plugin/;

#include "alor-audio-qrd.dtsi"
 / {
	model = "Qualcomm Technologies, Inc. Alor QRD + WCN7750 WLAN + Kundu";
	compatible = "qcom,alor-qrd", "qcom,alor", "qcom,qrd";
	qcom,msm-id = <685 0x10000>;
	qcom,board-id = <0x1000B 0>, <0x2000B 0>, <0x1010B 0>;
};
