//
/* Copyright (c) Qualcomm Technologies, Inc. and/or its subsidiaries.
 *  SPDX-License-Identifier: BSD-3-Clause-Clear
 */
/dts-v1/;
/plugin/;

#include "alor-audio-atp.dtsi"

/ {
	model = "Qualcomm Technologies, Inc. Alor ATP ";
	compatible = "qcom,alor-atp", "qcom,alor", "qcom,atp", "qcom,alorp-atp", "qcom,alorp";
	qcom,msm-id = <685 0x10000>, <727 0x10000>;
	qcom,board-id = <0x10021 0>;
};


