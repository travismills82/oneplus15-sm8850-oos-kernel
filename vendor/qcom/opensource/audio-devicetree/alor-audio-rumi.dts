//
/* Copyright (c) Qualcomm Technologies, Inc. and/or its subsidiaries.
 *  SPDX-License-Identifier: BSD-3-Clause-Clear
 */
/dts-v1/;
/plugin/;

#include "alor-audio-rumi.dtsi"

/ {
	model = "Qualcomm Technologies, Inc. Alor RUMI";
	compatible = "qcom,alor-rumi", "qcom,alor", "qcom,rumi";
	qcom,msm-id = <685 0x10000>;
	qcom,board-id = <15 0>;
};
