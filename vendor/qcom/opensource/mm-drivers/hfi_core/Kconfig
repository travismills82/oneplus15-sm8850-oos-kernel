## vendor/qcom/opensource/mm-drivers/hfi_core/Kconfig
```kconfig
config QTI_HFI_CORE
	bool "HFI Core"
	help
	  Enable the hfi_core module

config HFI_CORE_DEBUG_FS
	bool "HFI Core Debug"
	help
	  Enable the hfi_core debug module

config HFI_CORE_SERAPH
	bool "HFI Core Seraph"
	help
	  flag for seraph target
```
