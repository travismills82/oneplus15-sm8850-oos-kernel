/dts-v1/;
/plugin/;

#include "seraph-sde-display-idp-no-display.dtsi"

/ {
	model = "Qualcomm Technologies, Inc. Seraph IDP NO DISPLAY";
	compatible = "qcom,seraph-idp", "qcom,seraph", "qcom,idp";
	qcom,msm-id = <672 0x10000>, <673 0x10000>;
	qcom,board-id = <0x10022 2>, <0x10022 3>;
};

