/dts-v1/;
/plugin/;

#include "hw_fence/niobe-hw-fence.dtsi"

/ {
	model = "Qualcomm Technologies, Inc. Niobe QXR";
	compatible = "qcom,niobep-qxr", "qcom,niobep", "qcom,niobe-qxr", "qcom,niobe", "qcom,qxr";
	qcom,msm-id = <629 0x10000>, <652 0x10000>;
	qcom,board-id = <0x10026 0x1>, <0x10026 0>, <0x20026 0x1>;
};
